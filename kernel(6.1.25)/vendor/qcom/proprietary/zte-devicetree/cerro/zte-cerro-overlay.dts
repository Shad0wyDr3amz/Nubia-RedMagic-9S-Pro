/dts-v1/;
/plugin/;

#include "../zte-pineapple-common-overlay.dtsi"
#include "zte-cerro-overlay.dtsi"

/ {
    model = "Qualcomm Technologies, Inc. Pineapple MTP, zte board cerro";
    compatible = "qcom,pineapple-mtp", "qcom,pineapple", "qcom,pineapplep-mtp", "qcom,pineapplep", "qcom,mtp";
    qcom,msm-id = <557 0x10000>, <557 0x20000>, <577 0x10000>, <577 0x20000>;
    qcom,board-id = <8 0>;
};
